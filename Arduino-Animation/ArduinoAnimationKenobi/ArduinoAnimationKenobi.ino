// Author : Aldo Gordoni
// Date   : 04/03/2022

#include<Arduino.h>
#include<U8g2lib.h>
#include<Wire.h>

U8G2_SSD1306_128X64_NONAME_F_HW_I2C u8g2(U8G2_R0, /* reset=*/ U8X8_PIN_NONE);

// Copy the contents of your .xbm file below
#define kenobi_width 50
#define kenobi_height 50
const static unsigned char kenobi_array[1][458] PROGMEM = {
  { //kenobi picture
  0x00, 0x00, 0x00, 0x00, 0x00, 0x00, 0x00, 0x00, 0x00, 0x00, 0x00, 0x00, 
  0x00, 0x00, 0x00, 0x00, 0x00, 0x00, 0x00, 0x00, 0x00, 0x00, 0x00, 0xF0, 
  0x01, 0x00, 0x00, 0x00, 0x00, 0x00, 0xFE, 0x0F, 0x00, 0x00, 0x00, 0x00, 
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  0xFF, 0x03
  }
};

void drawAnimation(void) {
  // play images and animatio in our desired sequence order
  static uint8_t pointer = 0 ;
  static uint8_t yKenobi = 10;
  static uint8_t changeText = 0;
  
  u8g2.drawXBMP( 40, yKenobi, kenobi_width, kenobi_height, kenobi_array[0]);
  
  if(changeText<139){
    u8g2.setFont(u8g2_font_sticker_mel_tr);
    u8g2.drawStr(45,yKenobi-40,"Hello");
  } else {
    u8g2.setFont(u8g2_font_sticker_mel_tr);
    u8g2.drawStr(40,yKenobi-40,"There");
  }
  
  if(pointer<70){
    yKenobi++;
  } else {
   yKenobi--;
  }
  pointer++;
  changeText++;
  
  if(pointer>139){
    pointer = 0;
  }
  if(pointer>279){
  }
}

void setup(void) {
  u8g2.begin();
}

void loop(void) { 
  u8g2.firstPage();
  do {
    drawAnimation();
  } while ( u8g2.nextPage() );  
}
